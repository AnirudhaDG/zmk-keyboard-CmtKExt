## boards/shields/CmtKExt/Kconfig.defconfig
```kconfig
if SHIELD_CmtKExt
config ZMK_KEYBOARD_NAME
    default "CmtKExt"
config ZMK_USB
    default y
endif
```

## config/west.yml
```yaml
manifest:
  remotes:
    - name: zmkfirmware
      url-base: https://github.com/zmkfirmware
    - name: anirudhadg
      url-base: https://github.com/anirudhadg
  projects:
    - name: zmk
      remote: anirudhadg
      revision: main
      import:
        file: app/west.yml
  self:
    path: config
```
